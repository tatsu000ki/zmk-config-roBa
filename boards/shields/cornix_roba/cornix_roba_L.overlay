#include "cornix-layouts.dtsi"

/ {
    chosen {
        zmk,kscan = &kscan0;
    };

    kscan0: kscan {
        compatible = "zmk,kscan-gpio-matrix";
        diode-direction = "col2row";

        row-gpios = <&gpio0 4 GPIO_ACTIVE_LOW>;
        col-gpios = <&gpio0 6 GPIO_ACTIVE_LOW>;
    };
};
