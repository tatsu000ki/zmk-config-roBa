## boards/shields/cornix_roba/Kconfig.defconfig
```kconfig
if SHIELD_CORNIX_ROBA_R

config ZMK_KEYBOARD_NAME
    default "cornix_roba_R"

config ZMK_SPLIT
    default y

config ZMK_SPLIT_ROLE_CENTRAL
    default y

endif

if SHIELD_CORNIX_ROBA_L

config ZMK_KEYBOARD_NAME
    default "cornix_roba_L"

config ZMK_SPLIT
    default y

endif
```

## config/west.yml
```yaml
manifest:
  remotes:
    - name: zmkfirmware
      url-base: https://github.com/zmkfirmware
    - name: kumamuk-git
      url-base: https://github.com/kumamuk-git
  projects:
    - name: zmk
      remote: zmkfirmware
      revision: v0.3-branch
      import: app/west.yml
    - name: zmk-pmw3610-driver
      remote: kumamuk-git
      revision: main
    - name: temp-layer-threshold
      url: https://github.com/yamaryu211/zmk-input-processor-temp-layer-threshold
      revision: main
  self:
    path: config
```
